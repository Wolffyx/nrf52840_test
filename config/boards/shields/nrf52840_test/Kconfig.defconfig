## config/boards/shields/nrf52840_test/Kconfig.defconfig
```kconfig
if BOARD_NRF52840_TEST

config BOARD
	default "NRF52840_TEST"

# config BT_CTLR
# 	default BT

endif # BOARD_NRF52840DK_NRF52840
```
